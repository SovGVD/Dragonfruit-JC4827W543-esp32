## src/components/board/Kconfig.projbuild
```kconfig
menu "Dragonfruit board"
    choice DRAGONFRUIT_BOARD
        prompt "Hardware board"
        default BOARD_JC4827W543 if IDF_TARGET_ESP32S3
        default BOARD_M5PAPER

        config BOARD_JC4827W543
            bool "JC4827W543 (NV3041A QSPI)"
            depends on IDF_TARGET_ESP32S3

        config BOARD_M5PAPER
            bool "M5Paper (IT8951 / GT911)"
            depends on IDF_TARGET_ESP32
    endchoice

    choice DRAGONFRUIT_TOUCH
        prompt "JC4827W543 touchscreen"
        depends on BOARD_JC4827W543
        default TOUCH_XPT2046

        config TOUCH_XPT2046
            bool "Resistive (XPT2046 on shared SD SPI2 bus)"
        config TOUCH_GT911
            bool "Capacitive (GT911 on I2C)"
    endchoice
endmenu
```

## src/components/h8s/Kconfig
```kconfig
menu "Cybiko emulator"
    config CYBIKO_CORE_IRAM
        bool "Run the Cybiko CPU core from internal RAM"
        default y
        help
            Place the H8S interpreter and the Cybiko machine's per-instruction
            paths (bus access, peripheral timing) in internal RAM, with real
            jump tables for their switch statements. From flash the 32 KB
            interpreter does not fit the 16 KB instruction cache, and ESP-IDF
            turns every switch into a chain of compares. Costs about 48 KB of
            internal RAM, which the Palm 68k JIT cache then does not get.
endmenu
```

## src/components/m68k/Kconfig
```kconfig
menu "68k emulator"
    config M68K_JIT
        bool "68k -> Xtensa JIT"
        depends on IDF_TARGET_ESP32 || IDF_TARGET_ESP32S3
        default y
        help
            Compile hot ROM blocks to native Xtensa code on core 1's behalf
            (the compiler runs on core 0). Needs an executable heap, so on the
            ESP32-S3 it also needs ESP_SYSTEM_MEMPROT disabled. The code cache
            takes up to 104 KB of internal RAM; on the S3 it is sized to leave
            M68K_JIT_KEEP_INTERNAL_KB free for Wi-Fi and drivers. Turn it off
            to run the pure interpreter and keep that RAM.

    config M68K_JIT_KEEP_INTERNAL_KB
        int "Internal RAM to leave free when sizing the JIT cache (KB)"
        depends on M68K_JIT
        default 96 if IDF_TARGET_ESP32S3
        default 0
endmenu
```

## src/components/wifi_gateway/Kconfig
```kconfig
menu "Palm Wi-Fi gateway"
config PALM_WIFI_GATEWAY
    bool "Build PPP Wi-Fi gateway"
    default y if BOARD_JC4827W543
    default n
    select LWIP_PPP_SUPPORT
    select LWIP_PPP_SERVER_SUPPORT
    select LWIP_IP_FORWARD
    select LWIP_IPV4_NAPT
    select MBEDTLS_CERTIFICATE_BUNDLE
    help
        Enable serial.mode=wifi: direct serial PPP from Palm OS, Wi-Fi station,
        NAT, DNS relay and a small Wi-Fi setup portal. No IrDA or sync services.
endmenu
```
